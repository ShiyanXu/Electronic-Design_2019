#include "oled.h"
#include "stdlib.h"  	 
#include "delay.h"

const unsigned char Hzk[][32]={

{0x10,0x10,0xD0,0xFF,0x90,0x10,0x08,0xC8,0x49,0x4E,0x48,0xC8,0x08,0x08,0x00,0x00},
{0x04,0x03,0x00,0xff,0x00,0x83,0x00,0x1f,0x00,0x00,0x00,0x3f,0x40,0x40,0x78,0x00},/*"杭",0*/

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{0x04,0x04,0x04,0x04,0x04,0x44,0x84,0x7b,0x06,0x05,0x04,0x04,0x04,0x04,0x04,0x00},/*"学",8*/

};

const unsigned char F8X16[]=
 {
   0x00,0x00,0x00,0x00,0x00,0x00,0x00,0x00,0x00,0x00,0x00,0x00,0x00,0x00,0x00,0x00,// 0
   0x00,0x00,0x00,0xF8,0x00,0x00,0x00,0x00,0x00,0x00,0x00,0x33,0x30,0x00,0x00,0x00,//! 1
   0x00,0x10,0x0C,0x06,0x10,0x0C,0x06,0x00,0x00,0x00,0x00,0x00,0x00,0x00,0x00,0x00,//" 2
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   0x00,0x06,0x01,0x01,0x02,0x02,0x04,0x04,0x00,0x00,0x00,0x00,0x00,0x00,0x00,0x00,//~ 94
 };

 
//IO模拟SPI时序
void OLED_WR_Byte(uchar dat,uchar cmd)
{	
	uchar i;
	if(cmd)
		DC_H;
	else 
		DC_L;

	for(i=0;i<8;i++)
	{			  
		SCL_L;

		if(dat&0x80)
		   SDA_H;
		else
		   SDA_L;

		SCL_H;

		dat<<=1;   
	}				 		  
	
	DC_H;
} 

//坐标
void OLED_Set_Pos(unsigned char x, unsigned char y)
{
	OLED_WR_Byte(0xb0+y,OLED_CMD);
	OLED_WR_Byte(((x&0xf0)>>4)|0x10,OLED_CMD);
	OLED_WR_Byte((x&0x0f)|0x01,OLED_CMD);
}

//清屏
void OLED_Clear(void)  
{  
	u8 i,n;
	for(i=0;i<8;i++)
	{
		OLED_WR_Byte (0xb0+i,OLED_CMD);   
		OLED_WR_Byte (0x00,OLED_CMD);   
		OLED_WR_Byte (0x10,OLED_CMD);     
		for(n=0;n<128;n++)OLED_WR_Byte(0,OLED_DATA);
	} 
}

//字符显示 
void OLED_ShowChar(u8 x,u8 y,u8 chr)
{
	unsigned char c=0,i=0;
		c=chr-' ';
		if(x>Max_Column-1)
			{x=0;y=y+2;}

		OLED_Set_Pos(x,y);

		for(i=0;i<8;i++)
			OLED_WR_Byte(F8X16[c*16+i],OLED_DATA);

		OLED_Set_Pos(x,y+1);

		for(i=0;i<8;i++)
			OLED_WR_Byte(F8X16[c*16+i+8],OLED_DATA);
}

//字符串长度与自动添加判断
u32 oled_pow(u8 m,u8 n)
{
	u32 result=1;
	while(n--)result*=m;
	return result;
}

//数字显示
//x:横坐标
//y:纵坐标,如果是8*16的字符，每一行相隔2个单位，例如0是第一行，2是第二行
//num：数值
//len:数值长度，例如需要显示98，就是两位数，需要显示1995就是4位数，五位数也可以显示1995，就是01995，我的程序是自动补0
void OLED_ShowNum(u8 x,u8 y,u32 num,u8 len)
{
	u8 t,temp;
	u8 enshow=0;
	for(t=0;t<len;t++)
	{
		temp=(num/oled_pow(10,len-t-1))%10;
		if(enshow==0&&t<(len-1))
		{
			if(temp==0)
			{
				OLED_ShowChar(x+(16/2)*t,y,'0');		//如果需要显示01995变成 1995（前面补空格），就把这个函数里面的‘0’改为‘ ’
				continue;
			}else enshow=1;

		}
	 	OLED_ShowChar(x+(16/2)*t,y,temp+'0');
	}
}

//字符串显示
void OLED_ShowString(u8 x,u8 y,u8 *chr)
{
	unsigned char j=0;
	while (chr[j]!='\0')
	{		OLED_ShowChar(x,y,chr[j]);
			x+=8;
		if(x>120){x=0;y+=2;}
			j++;
	}
}

//IO初始化设置
//OLED初始化
void OLED_Init(void)
{
	GPIO_InitTypeDef  GPIO_InitStructure;

  RCC_AHB1PeriphClockCmd(RCC_AHB1Periph_GPIOF, ENABLE);				

  GPIO_InitStructure.GPIO_Pin = GPIO_Pin_0|GPIO_Pin_1|GPIO_Pin_2|GPIO_Pin_3;			
  GPIO_InitStructure.GPIO_Mode = GPIO_Mode_OUT;							
  GPIO_InitStructure.GPIO_OType = GPIO_OType_PP;						
  GPIO_InitStructure.GPIO_Speed = GPIO_Speed_100MHz;				
  GPIO_InitStructure.GPIO_PuPd = GPIO_PuPd_UP;							
  GPIO_Init(GPIOF, &GPIO_InitStructure);										

	RST_H;
	delay_ms(100);
	RST_L;
	delay_ms(100);
	RST_H;

	OLED_WR_Byte(0xAE,OLED_CMD);//--turn off oled panel
	OLED_WR_Byte(0x00,OLED_CMD);//---set low column address
	OLED_WR_Byte(0x10,OLED_CMD);//---set high column address
	OLED_WR_Byte(0x40,OLED_CMD);//--set start line address  Set Mapping RAM Display Start Line (0x00~0x3F)
	OLED_WR_Byte(0x81,OLED_CMD);//--set contrast control register
	OLED_WR_Byte(0xCF,OLED_CMD); // Set SEG Output Current Brightness
	OLED_WR_Byte(0xA1,OLED_CMD);//--Set SEG/Column Mapping     0xa0???? 0xa1??
	OLED_WR_Byte(0xC8,OLED_CMD);//Set COM/Row Scan Direction   0xc0???? 0xc8??
	OLED_WR_Byte(0xA6,OLED_CMD);//--set normal display
	OLED_WR_Byte(0xA8,OLED_CMD);//--set multiplex ratio(1 to 64)
	OLED_WR_Byte(0x3f,OLED_CMD);//--1/64 duty
	OLED_WR_Byte(0xD3,OLED_CMD);//-set display offset	Shift Mapping RAM Counter (0x00~0x3F)
	OLED_WR_Byte(0x00,OLED_CMD);//-not offset
	OLED_WR_Byte(0xd5,OLED_CMD);//--set display clock divide ratio/oscillator frequency
	OLED_WR_Byte(0x80,OLED_CMD);//--set divide ratio, Set Clock as 100 Frames/Sec
	OLED_WR_Byte(0xD9,OLED_CMD);//--set pre-charge period
	OLED_WR_Byte(0xF1,OLED_CMD);//Set Pre-Charge as 15 Clocks & Discharge as 1 Clock
	OLED_WR_Byte(0xDA,OLED_CMD);//--set com pins hardware configuration
	OLED_WR_Byte(0x12,OLED_CMD);
	OLED_WR_Byte(0xDB,OLED_CMD);//--set vcomh
	OLED_WR_Byte(0x40,OLED_CMD);//Set VCOM Deselect Level
	OLED_WR_Byte(0x20,OLED_CMD);//-Set Page Addressing Mode (0x00/0x01/0x02)
	OLED_WR_Byte(0x02,OLED_CMD);//
	OLED_WR_Byte(0x8D,OLED_CMD);//--set Charge Pump enable/disable
	OLED_WR_Byte(0x14,OLED_CMD);//--set(0x10) disable
	OLED_WR_Byte(0xA4,OLED_CMD);// Disable Entire Display On (0xa4/0xa5)
	OLED_WR_Byte(0xA6,OLED_CMD);// Disable Inverse Display On (0xa6/a7)
	OLED_WR_Byte(0xAF,OLED_CMD);//--turn on oled panel

	OLED_WR_Byte(0xAF,OLED_CMD); /*display ON*/
	OLED_Clear();
	OLED_Set_Pos(0,0);
}  

//打开OLED    
void OLED_Display_On(void)
{
	OLED_WR_Byte(0X8D,OLED_CMD);  
	OLED_WR_Byte(0X14,OLED_CMD);  
	OLED_WR_Byte(0XAF,OLED_CMD);  
}
//关闭OLED    
void OLED_Display_Off(void)
{
	OLED_WR_Byte(0X8D,OLED_CMD);  
	OLED_WR_Byte(0X10,OLED_CMD);  
	OLED_WR_Byte(0XAE,OLED_CMD); 
}

//显示汉字
void OLED_ShowCHinese(u8 x,u8 y,u8 no)
{      			    
	u8 t,adder=0;
	OLED_Set_Pos(x,y);	
    for(t=0;t<16;t++)
		{
				OLED_WR_Byte(Hzk[2*no][t],OLED_DATA);
				adder+=1;
     }	
		OLED_Set_Pos(x,y+1);	
    for(t=0;t<16;t++)
			{	
				OLED_WR_Byte(Hzk[2*no+1][t],OLED_DATA);
				adder+=1;
      }					
}

